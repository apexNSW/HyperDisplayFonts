/*
 * Font support developed by apexNSW.  
 * This sketch has 8-bit style font support for HyperDisplay. 
 * 
 * Free to use and redistribute. No warranties.
 * 
 * 
 */
#include "HyperDisplay_4DLCD-320240_4WSPI.h" // Click here to get the library: https://github.com/sparkfun/HyperDisplay_4DLCD-320240_ArduinoLibrary

#define SERIAL_PORT Serial    

#define PWM_PIN PWM0             
#define CS_PIN D0
#define DC_PIN D1
#define SPI_PORT SPI
#define SPI_SPEED 32000000        

LCD320240_4WSPI myTFT;           

ILI9341_color_16_t defaultColor; 

const int ascii_offset = 32;
//character representations 1056 bytes
byte aip_bin_chars[][8] = {
    {0x00,0x00,0x00,0x00,0x00,0x00,0x00,0x00}, //(space) ASCII 32 = offset -32
    {0x00,0x40,0x40,0x40,0x40,0x00,0x00,0x40}, //!
    {0x00,0x24,0x24,0x24,0x00,0x00,0x00,0x00}, //"
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    {0x00,0x00,0x42,0x42,0x42,0x46,0xba,0x80}, //µ
};                                           
void setup() {
  SERIAL_PORT.begin(115200);
  SERIAL_PORT.println("AIP HyperDisplay Fonts for SparkFun TFT LCD 2.4in");
  myTFT.begin(DC_PIN, CS_PIN, PWM_PIN, SPI_PORT, SPI_SPEED);  
  myTFT.setInterfacePixelFormat(ILI9341_PXLFMT_16);
  myTFT.clearDisplay();                                       
  defaultColor = myTFT.rgbTo16b( 255, 255, 255 );
  myTFT.setCurrentWindowColorSequence((color_t)&defaultColor); 
}
void loop() {
  demo1();
  delay(10000);
  demo2();
  demo3();
}
void demo3() {
  myTFT.clearDisplay();
  ILI9341_color_16_t color = myTFT.rgbTo16b( 0, 51, 102 );
  myTFT.fillWindow((color_t)&color);

  ILI9341_color_16_t smallTXTcolor = myTFT.rgbTo16b( 102, 178, 255 );
  
  int xscreenmax = 240;
  int yscreenmax = 320;
  int minsize = 8;
  int rotate = 0;
  for(int fontsize=8;fontsize>=1;fontsize--) {
    myTFT.fillWindow((color_t)&color);
    int scaled = minsize*fontsize;
    int charspercol = floor(yscreenmax/scaled);
    int charsperrow = floor(xscreenmax/scaled);
    int startx = 0;
    int starty = 0;
    int rowctr = 0;
    int colctr = 0;
    int allchars = sizeof(aip_bin_chars)/sizeof(aip_bin_chars[0]);
    for(int cc=0;cc<allchars;cc++) {
      draw_character_bits(cc, startx, starty, fontsize, rotate, smallTXTcolor);
      delay(100);
      if (cc == (allchars-1)) delay(2900);
      startx+=scaled;
      rowctr++;
      if (rowctr == charsperrow) {
        rowctr = 0;
        colctr++;
        startx=0;
        starty+=scaled;
      }
      if (colctr == charspercol) {
        delay(3000);
        startx = 0;
        starty = 0;
        rowctr = 0;
        colctr = 0;
        myTFT.fillWindow((color_t)&color);
      }
    }
  }
}
void demo2() {
  myTFT.clearDisplay();
  ILI9341_color_16_t color = myTFT.rgbTo16b( 0, 51, 102 );
  myTFT.fillWindow((color_t)&color);

  ILI9341_color_16_t smallTXTcolor = myTFT.rgbTo16b( 102, 178, 255 );
  
  int xscreenmax = 240;
  int yscreenmax = 320;
  int minsize = 8;
  int rotate = 90;
  for(int fontsize=8;fontsize>=1;fontsize--) {
    myTFT.fillWindow((color_t)&color);
    int scaled = minsize*fontsize;
    int charspercol = floor(xscreenmax/scaled);
    int charsperrow = floor(yscreenmax/scaled);
    int pagex = floor(xscreenmax - scaled);
    int startx = pagex;
    int starty = 0;
    int rowctr = 0;
    int colctr = 0;
    int allchars = sizeof(aip_bin_chars)/sizeof(aip_bin_chars[0]);
    for(int cc=0;cc<allchars;cc++) {
      draw_character_bits(cc, startx, starty, fontsize, rotate, smallTXTcolor);
      delay(100);
      if (cc == (allchars-1)) delay(2900);
      starty+=scaled;
      rowctr++;
      if (rowctr == charsperrow) {
        rowctr = 0;
        colctr++;
        startx-=scaled;
        starty = 0;
      }
      if (colctr == charspercol) {
        delay(3000);
        startx = pagex;
        starty = 0;
        rowctr = 0;
        colctr = 0;
        myTFT.fillWindow((color_t)&color);
      }
    }
  }
}
void demo1() {
  //displays the day, time, and date (not live) in different font sizes, offset from center
  myTFT.clearDisplay();
  
  ILI9341_color_16_t color = myTFT.rgbTo16b( 0, 51, 102 );
  myTFT.fillWindow((color_t)&color);

  ILI9341_color_16_t smallTXTcolor = myTFT.rgbTo16b( 102, 178, 255 );
  
  char dayofweek[7] = "Friday";
  aip_print_characters(dayofweek,0,0,3,90,1,40,0,smallTXTcolor);
  
  char timeofday[6] = "10:24";
  aip_print_characters(timeofday,25,85,6,90,1,0,0,smallTXTcolor);
  
  char datestr[17] = "January 14, 2022";
  aip_print_characters(datestr,0,0,2,90,1,-40,0,smallTXTcolor);
  
}
int bin_string_to_int(String bin) {
  int out = 0;
  int base = 2;
  for(int i=bin.length()-1;i>=0;i--) {
    int sft = abs(i-7);
    int ctot = pow(base,sft);
    if (bin[i] == '1') out+=ctot;
  }
  return out;
}
void stack_bit_array(byte stackedArray[], int order, int charidx) {
  int len = 0;
  int ind = 0;
  String temp = "";
  int next;
  String tempArr[8];
  int binint = 0;
  switch(order) {
    case 0:
    default:
        for(int i=0;i<8;i++) {
          temp = "";
          for(int j=7;j>=0;j--) {
            next = bitRead(aip_bin_chars[charidx][i],j);
            if (next) {
              temp.concat("1");
            } else {
              temp.concat("0");
            }
          }
          tempArr[ind] = temp;
          len = 0;
          ind++;
        }
      break;
    case 1:
        for(int col=7;col>=0;col--) {
          temp = "";
          for(int row=7;row>=0;row--) {
            next = bitRead(aip_bin_chars[charidx][row],col);
            if (next) {
              temp.concat("1");
            } else {
              temp.concat("0");
            }
          }
          tempArr[ind] = temp;
          len = 0;
          ind++;
        }
      break;
    case 2:
        for(int row=7;row>=0;row--) {
          temp = "";
          for(int col=0;col<8;col++) {
            next = bitRead(aip_bin_chars[charidx][row],col);
            if (next) {
              temp.concat("1");
            } else {
              temp.concat("0");
            }
          }
          tempArr[ind] = temp;
          len = 0;
          ind++;
        }
      break;
    case 3:
        for(int col=0;col<8;col++) {
          temp = "";
          for(int row=0;row<8;row++) {
            next = bitRead(aip_bin_chars[charidx][row],col);
            if (next) {
              temp.concat("1");
            } else {
              temp.concat("0");
            }
          }
          tempArr[ind] = temp;
          len = 0;
          ind++;
        }
      break;
  }
  for(int i=0;i<8;i++) {
          binint = bin_string_to_int(tempArr[i]);
          stackedArray[i] = byte(binint);
  }
}
void draw_character_bits(int idx, int x1, int y1, int factor, int rotate, ILI9341_color_16_t txtcolor) {
  int order;
  int minsize = 8;
  switch(rotate) {
    case 0:
    default:
      order = 0;
      break;
    case 90:
      order = 1;
      break;
    case 180:
      order = 2;
      break;
    case 270:
      order = 3;
      break;
  }
  byte stackedArray[8];
  stack_bit_array(stackedArray,order,idx);

  for(int i=0;i<8;i++) {
    for(int j=7;j>=0;j--) {
      int px1,py1,px2,py2;
      int xoff,yoff;
      int sft;
      sft = abs(j-7);
      yoff = factor*i;
      xoff = factor*sft;
      px1 = x1+xoff;
      py1 = y1+yoff;
      px2 = px1+factor;
      py2 = py1+factor;
      if (bitRead(stackedArray[i],j)) {
        myTFT.rectangle(px1,py1,px2,py2,true,(color_t)&txtcolor);
      }
    }
  }
}
void reverse_chars(char chars[]) {
  int idx = 0;
  int count = strlen(chars);
  char reversed[count];
  for(int i=count-1;i>=0;i--) {
    reversed[idx] = chars[i];
    idx++;
  }
  reversed[idx] = '\0';
  int rcount = strlen(reversed);
  for(int i=0;i<strlen(reversed);i++) {
    chars[i] = reversed[i];
  }
}
int snap_rotation(int rotate) {
  if (rotate >= 360) rotate = rotate%360;
  if (rotate == 0) return rotate;
  if (rotate == 90) return rotate;
  if (rotate == 180) return rotate;
  if (rotate == 270) return rotate;
  if (rotate > 0 && rotate < 90) return 90;
  if (rotate > 90 && rotate < 180) return 180;
  if (rotate > 180 && rotate < 270) return 270;
  return 0;
}
void aip_print_characters(char chars[], int startx, int starty, int factor, int rotate, int center, int coffx, int coffy, ILI9341_color_16_t txtcolor) {
  int screentotx = 240;
  int screentoty = 320;
  int minsize = 8;
  int scaled = minsize*factor;
  int totchars = strlen(chars);
  rotate = snap_rotation(rotate);
  if (rotate == 180 || rotate == 270) {
    reverse_chars(chars);
  }
  if (center) {
    switch(rotate) {
      case 0:
      case 180:
      default:
        startx = floor((screentotx - (scaled*totchars))/2)+coffx;
        starty = floor((screentoty-scaled)/2)+coffy;
        break;
      case 90:
      case 270:
        startx = floor((screentotx-scaled)/2)+coffx;
        starty = floor((screentoty - (scaled*totchars))/2)+coffy;
        break;
    }
  }
  for(int i=0;i<totchars;i++) {
    int idx = int(chars[i])-ascii_offset;
    switch(rotate) {
      case 0:
      default:
        if (i > 0) startx+=scaled;
        break;
      case 90:
        if (i > 0) starty+=scaled;
        break;
      case 180:
        if (i > 0) startx+=scaled;
        break;
      case 270:
        if (i > 0) starty+=scaled;
        break;
    }
    draw_character_bits(idx,startx,starty,factor,rotate,txtcolor);
  }
}
